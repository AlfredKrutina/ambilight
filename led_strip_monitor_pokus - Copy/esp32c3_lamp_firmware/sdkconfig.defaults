## led_strip_monitor_pokus - Copy/esp32c3_lamp_firmware/sdkconfig.defaults
```kconfig
# Sladění s partitions.csv (otadata + 2× OTA; mapa ~3,9 MB) — modul musí mít fyzicky 4 MB flash.
# Bez tohoto se po set-target / novém klonu často vrátí výchozí 2 MB a gen_esp32part spadne.
CONFIG_ESPTOOLPY_FLASHSIZE_4MB=y
# Jemnější tick kvůli čekáním v boot vlnové animaci (~100 LED/s včetně refresh).
CONFIG_FREERTOS_HZ=1000
```

## led_strip_monitor_pokus - Copy/esp_mqtt_light/esp-homekit_respb_try_V1/main/Kconfig.projbuild
```kconfig
menu "Alfred LED Controller Configuration"

    config LED_STRIP_GPIO
        int "LED Strip GPIO Pin"
        range 0 48
        default 8
        help
            GPIO pin connected to LED strip data line (WS2812B DIN).
            For ESP32-C6, use any available GPIO (e.g., GPIO8).

    config LED_STRIP_NUM_LEDS
        int "Number of LEDs in strip"
        range 1 300
        default 60
        help
            Total number of addressable LEDs in the strip.
            Used for memory allocation and animation calculations.

    config MQTT_BROKER_IP
        string "MQTT Broker IP Address"
        default "192.168.1.125"
        help
            IP address or hostname of the MQTT broker (Raspberry Pi).
            Format: "mqtt://192.168.1.125" or "mqtt://hostname.local"

    config PROV_DEVICE_NAME
        string "BLE Provisioning Device Name"
        default "Alfred-C6"
        help
            Name visible during BLE provisioning in ESP BLE Prov app.
            Will be appended with last 3 MAC address bytes for uniqueness.

    config PROV_POP_PASSWORD
        string "Provisioning Proof of Possession Password"
        default "abcd1234"
        help
            Password for secure BLE provisioning (Security 1).
            Must match password entered in provisioning app.

endmenu
```

## led_strip_monitor_pokus - Copy/esp_mqtt_light/esp-homekit_respb_try_V1/sdkconfig.defaults
```kconfig
# Wi-Fi Provisioning
CONFIG_BT_ENABLED=y
CONFIG_BT_BLUEDROID_ENABLED=y
CONFIG_BT_BLE_ENABLED=y
CONFIG_BT_BLE_42_FEATURES_SUPPORTED=y
CONFIG_BT_GATTS_ENABLE=y
CONFIG_BT_GATTC_ENABLE=y

# MQTT Configuration
CONFIG_MQTT_PROTOCOL_311=y
CONFIG_MQTT_TRANSPORT_SSL=n
CONFIG_MQTT_TRANSPORT_WEBSOCKET=n

# Wi-Fi Configuration
CONFIG_ESP_WIFI_SSID=""
CONFIG_ESP_WIFI_PASSWORD=""

# Logging
CONFIG_LOG_DEFAULT_LEVEL_INFO=y
CONFIG_LOG_MAXIMUM_LEVEL_VERBOSE=y

# FreeRTOS
CONFIG_FREERTOS_HZ=1000

# Partition table - custom for larger app size
CONFIG_PARTITION_TABLE_CUSTOM=y
CONFIG_PARTITION_TABLE_CUSTOM_FILENAME="partitions.csv"
CONFIG_PARTITION_TABLE_FILENAME="partitions.csv"

# Flash size - 4MB for ESP32-C6
CONFIG_ESPTOOLPY_FLASHSIZE_4MB=y
```
